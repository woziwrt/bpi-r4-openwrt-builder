## configs/defconfig
```kconfig
CONFIG_TARGET_mediatek=y
CONFIG_TARGET_MULTI_PROFILE=y
CONFIG_TARGET_DEVICE_mediatek_filogic_DEVICE_mediatek_mt7981-rfb=y
CONFIG_TARGET_DEVICE_mediatek_filogic_DEVICE_mediatek_mt7986a-rfb-nand=y
CONFIG_TARGET_DEVICE_mediatek_filogic_DEVICE_mediatek_mt7988a-rfb=y
CONFIG_TARGET_DEVICE_mediatek_filogic_DEVICE_mediatek_mt7986b-rfb=y
# CONFIG_KERNEL_DEBUG_INFO_REDUCED is not set
# CONFIG_KERNEL_KEYS is not set
CONFIG_KERNEL_CGROUP_FREEZER=y
CONFIG_KERNEL_CGROUP_DEVICE=y
# CONFIG_KERNEL_MEMCG_SWAP is not set
# CONFIG_KERNEL_CFS_BANDWIDTH is not set
# CONFIG_KERNEL_BLK_DEV_THROTTLING is not set
CONFIG_KERNEL_NET_CLS_CGROUP=y
CONFIG_USE_GC_SECTIONS=y
CONFIG_USE_LTO=y
CONFIG_USE_MOLD=y
CONFIG_PACKAGE_blockd=y
CONFIG_BUSYBOX_CUSTOM=y
CONFIG_BUSYBOX_CONFIG_TFTP=y
CONFIG_BUSYBOX_CONFIG_FEATURE_TFTP_GET=y
CONFIG_BUSYBOX_CONFIG_FEATURE_TFTP_PUT=y
CONFIG_BUSYBOX_CONFIG_VCONFIG=y
CONFIG_BUSYBOX_CONFIG_MPSTAT=y
# CONFIG_DROPBEAR_ED25519 is not set
# CONFIG_PACKAGE_trusted-firmware-a-mt7981-ram-ddr3 is not set
# CONFIG_PACKAGE_trusted-firmware-a-mt7981-ram-ddr4 is not set
# CONFIG_PACKAGE_trusted-firmware-a-mt7986-ram-ddr3 is not set
# CONFIG_PACKAGE_trusted-firmware-a-mt7986-ram-ddr4 is not set
# CONFIG_PACKAGE_trusted-firmware-a-mt7988-ram-comb is not set
CONFIG_PACKAGE_kmod-ata-core=y
CONFIG_PACKAGE_kmod-scsi-generic=y
CONFIG_PACKAGE_kmod-fs-exfat=y
CONFIG_PACKAGE_kmod-fs-ext4=y
CONFIG_PACKAGE_kmod-fs-msdos=y
CONFIG_PACKAGE_kmod-fs-nfsd=y
CONFIG_PACKAGE_kmod-fs-f2fs=y
CONFIG_PACKAGE_kmod-fs-ntfs3=y
CONFIG_PACKAGE_kmod-gpio-pca953x=y
CONFIG_PACKAGE_kmod-hwmon-pwmfan=y
CONFIG_PACKAGE_kmod-i2c-gpio=y
CONFIG_PACKAGE_kmod-i2c-mux-gpio=y
CONFIG_PACKAGE_kmod-i2c-mux-pca9541=y
CONFIG_PACKAGE_kmod-i2c-mux-pca954x=y
CONFIG_PACKAGE_kmod-ipt-conntrack=y
CONFIG_PACKAGE_kmod-ipt-extra=y
CONFIG_PACKAGE_kmod-ipt-nat=y
CONFIG_PACKAGE_kmod-ipt-offload=y
CONFIG_PACKAGE_kmod-phy-airoha-an8801sb=y
CONFIG_PACKAGE_kmod-phy-airoha-en8811h=y
CONFIG_PACKAGE_kmod-phy-as21xxx=y
CONFIG_PACKAGE_kmod-phy-marvell=y
CONFIG_PACKAGE_kmod-phy-marvell-10g=y
CONFIG_PACKAGE_kmod-eeprom-at24=y
CONFIG_PACKAGE_kmod-rtc-pcf8563=y
CONFIG_PACKAGE_kmod-usb-storage-extras=y
CONFIG_PACKAGE_kmod-usb-storage-uas=y
CONFIG_PACKAGE_kmod-mt7996-firmware=y
CONFIG_PACKAGE_as21xxx-firmware=y
CONFIG_PACKAGE_libmount=y
CONFIG_PACKAGE_libwebsockets-full=y
CONFIG_PACKAGE_libuv=y
CONFIG_PACKAGE_libcap=y
CONFIG_PACKAGE_kmod-crypto-crc32=y
CONFIG_PACKAGE_kmod-ip6tables-extra=y
CONFIG_PACKAGE_ttyd=y
CONFIG_PACKAGE_luci=y
CONFIG_PACKAGE_luci-compat=y
CONFIG_PACKAGE_luci-app-ksmbd=y
CONFIG_PACKAGE_luci-app-ttyd=y
CONFIG_PACKAGE_mii_mgr=y
CONFIG_PACKAGE_regs=y
CONFIG_PACKAGE_switch=y
CONFIG_PACKAGE_mtk_factory_rw=y
CONFIG_PACKAGE_netsys_dbg_util=y
CONFIG_PACKAGE_lftp=y
CONFIG_PACKAGE_ip6tables-zz-legacy=y
CONFIG_PACKAGE_ip6tables-extra=y
CONFIG_PACKAGE_iptables-mod-extra=y
CONFIG_PACKAGE_iptables-mod-ipopt=y
CONFIG_PACKAGE_iptables-zz-legacy=y
CONFIG_PACKAGE_ip-bridge=y
CONFIG_PACKAGE_ip-full=y
CONFIG_PACKAGE_xl2tpd=y
CONFIG_PACKAGE_ethtool=y
CONFIG_PACKAGE_mtkhnat_util=y
CONFIG_PACKAGE_ppp-mod-pptp=y
CONFIG_PACKAGE_tcpdump=y
CONFIG_PACKAGE_gpioctl-sysfs=y
CONFIG_PACKAGE_gpiod-tools=y
CONFIG_PACKAGE_i2c-tools=y
CONFIG_PACKAGE_iio-utils=y
CONFIG_PACKAGE_pciutils=y
CONFIG_PACKAGE_spidev-test=y
CONFIG_PACKAGE_usbutils=y
```
